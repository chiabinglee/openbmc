## meta-openbmc-machines/meta-openpower/meta-chiabing/meta-p8-4s/conf/machine/p8-4s.conf
```bitbake
KMACHINE = "aspeed"
KERNEL_DEVICETREE = "${KMACHINE}-bmc-opp-${MACHINE}.dtb"

require conf/machine/include/ast2400.inc
require conf/machine/include/obmc-bsp-common.inc
require conf/machine/include/chiabing.inc
require conf/machine/include/p8.inc

UBOOT_MACHINE_p8-4s = "ast_g4_ncsi_config"
UBOOT_ENTRYPOINT = "0x40008000"
UBOOT_LOADADDRESS = "0x40008000"

FLASH_SIZE = "32768"

PREFERRED_PROVIDER_virtual/phosphor-ipmi-fru-inventory = "p8-4s-ipmi-inventory-map-native"
PREFERRED_PROVIDER_virtual/phosphor-led-manager-config-native = "p8-4s-led-manager-config-native"
```

## meta-openbmc-machines/meta-openpower/meta-msi/conf/layer.conf
```bitbake
# We have a conf and classes directory, add to BBPATH
BBPATH .= ":${LAYERDIR}"

BBFILE_COLLECTIONS += "msi"
BBFILE_PATTERN_msi = ""
```
